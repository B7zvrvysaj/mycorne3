## config/west.yml
```yaml
manifest:
  remotes:
    - name: zmkfirmware
      url-base: https://github.com/zmkfirmware
    - name: zephyrproject
      url-base: https://github.com/zephyrproject-rtos
  projects:
    - name: zmk
      remote: zmkfirmware
      revision: main  # Укажи main для последней версии с Studio
      import:
        path-prefix: zmk
    - name: zephyr
      remote: zephyrproject
      revision: main
      import: true
  self:
    path: config
```
